## config/west.yml
```yaml
manifest:
  defaults:
    revision: v0.3

  remotes:
    - name: zmkfirmware
      url-base: https://github.com/zmkfirmware

  projects:
    - name: zmk
      remote: zmkfirmware
      import: app/west.yml

    - name: zmk-keyboard-totem
      url: https://github.com/Talha-Ak/zmk-keyboard-totem
      revision: main

    - name: zmk-rgbled-widget
      url: https://github.com/caksoylar/zmk-rgbled-widget

  self:
    path: config
```
